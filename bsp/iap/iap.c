/*
 * @Author: your name
 * @Date: 2020-08-31 18:49:02
 * @LastEditTime: 2020-09-01 21:46:37
 * @LastEditors: Please set LastEditors
 * @Description: In User Settings Edit
 * @FilePath: \bootloader引导程序\Src\iap.c
 */
#include "main.h"
#include "iap.h"

static const uint8_t s_CRCH[] = {
0x00, 0xC1, 0x81, 0x40, 0x01, 0xC0, 0x80, 0x41, 0x01, 0xC0, 0x80, 0x41, 0x00, 0xC1, 0x81,
0x40, 0x01, 0xC0, 0x80, 0x41, 0x00, 0xC1, 0x81, 0x40, 0x00, 0xC1, 0x81, 0x40, 0x01, 0xC0,
0x80, 0x41, 0x01, 0xC0, 0x80, 0x41, 0x00, 0xC1, 0x81, 0x40, 0x00, 0xC1, 0x81, 0x40, 0x01,
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0x00, 0xC1, 0x81, 0x40, 0x01, 0xC0, 0x80, 0x41, 0x01, 0xC0, 0x80, 0x41, 0x00, 0xC1, 0x81,
0x40
} ;
// CRC 低位字节值表
const uint8_t s_CRCLo[] = {

0x00, 0xC0, 0xC1, 0x01, 0xC3, 0x03, 0x02, 0xC2, 0xC6, 0x06, 0x07, 0xC7, 0x05, 0xC5, 0xC4,
0x04, 0xCC, 0x0C, 0x0D, 0xCD, 0x0F, 0xCF, 0xCE, 0x0E, 0x0A, 0xCA, 0xCB, 0x0B, 0xC9, 0x09,
0x08, 0xC8, 0xD8, 0x18, 0x19, 0xD9, 0x1B, 0xDB, 0xDA, 0x1A, 0x1E, 0xDE, 0xDF, 0x1F, 0xDD,
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0x44, 0x84, 0x85, 0x45, 0x87, 0x47, 0x46, 0x86, 0x82, 0x42, 0x43, 0x83, 0x41, 0x81, 0x80,
0x40
};

uint16_t cal_crc16(const uint8_t* _pBuf, uint32_t _len)
{
	uint8_t ucCRCH = 0xFF;
	uint8_t ucCRCL = 0xFF;
	int usIndex;

	while(_len--)
	{
		usIndex = ucCRCH^*(_pBuf++);  /*计算CRC*/
		ucCRCH = (uint8_t)(ucCRCL ^ s_CRCH[usIndex]);
		ucCRCL = s_CRCLo[usIndex];
	}
	return ((uint16_t)ucCRCH<<8|ucCRCL);
}


void iap_load_app(uint32_t app_addr)
{
    uint32_t jump_addr;
    jump_addr = *(__IO uint32_t*) (app_addr + 4);
    __set_MSP(*(__IO uint32_t*) app_addr);
    (*( void (*)( ) )jump_addr) ();
}

int iap_recv_proc(uint8_t *data, uint16_t *length,uint32_t timeout)
{
    uint16_t recv_size = 0;
		uint16_t crc;
    *length = 0;

    recv_size = uart_recv_data(data, 1040, timeout);
    if(recv_size == 0) //没收到数据
    {
        return 2;
    }

    if(data[0] == 0x7e && data[recv_size -1] == 0x7f)
    {
			if(data[3] != 0X29) 
			{
				*length = ((uint16_t)(data[8] << 8) | data[9] - 1);	//大小端转换  高字节在前低字节在后
			}
			crc = cal_crc16(data, recv_size - 3);
			if(crc == ((uint16_t )(data[recv_size - 2] << 8) | data[recv_size - 3]))
			{
				return 0;
			}
			else 
			{
				return 3;
			}
    }
    return 1;
}

/************
 * 发送应答数据
************/
void iap_ack(uint8_t *p_msg, uint16_t msg_len, uint16_t data_len)
{
		uint8_t boot_info[64] = {0X7E, 0X02, 0X05, 0X01, 0X01};
    uint8_t index = 5;

    uint16_t crc;

    boot_info[index++] = msg_len >> 8;
    boot_info[index++] = msg_len;
    boot_info[index++] = 0x01;
    boot_info[index++] = data_len >> 8;
    boot_info[index++] = data_len;

    memcpy(&boot_info[index], p_msg, data_len);//数据拷贝
	index += data_len;  
    
	crc = cal_crc16(&boot_info[0], index);//计算校验和
	boot_info[index++] = crc;
	boot_info[index++] = crc >> 8;
	boot_info[index++] = 0X7F;
	uart_transmit_buf(boot_info, index);
}

uint8_t flash_buff[1024];

void iap_write_flash(uint8_t *msg, uint16_t lenght)
{
	char write_page[15] = {""};	
	char page[4];	
	
	memcpy(flash_buff, &msg[11], lenght); //拷贝数据
	//程序写进flash 10k空间
	flash_write_buff(APPLICATION_ADDRESS_OFFSET + 1024 * msg[10], (uint32_t *)flash_buff, lenght / 4);

	strcat( write_page, "Page[" ); 
    sprintf(page,"%d",msg[10]);
	strcat(write_page,page); 
    strcat(write_page,"] OK\r\n");
	
	iap_ack((uint8_t *)write_page, strlen(write_page) + 3, strlen(write_page));
}
void iap_done(void)
{
	uint32_t save_flag;
	save_flag = 0X12345678;
	LL_FLASH_PageErase(FLASH, APP_UPDATE_FLAG); //擦除地址内的数据
	flash_write_buff(APP_UPDATE_FLAG, &save_flag, 1);//程序写进地址内
	iap_load_app(APPLICATION_ADDRESS_OFFSET);//跳转并加载
}
